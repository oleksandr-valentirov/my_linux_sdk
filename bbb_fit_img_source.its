## bbb_fit_img_source.its
```
/dts-v1/;

/ {
        description = "BeagleBone Black FIT Image";
        #address-cells = <1>;

        images {
                kernel {
                        description = "Kernel";
                        data = /incbin/("./linux/arch/arm/boot/zImage");
                        type = "kernel";
                        arch = "ARM";
                        os = "linux";
                        compression = "none";
                        load = <0x82000000>;
                        entry = <0x82000000>;
                        hash {
                                algo = "sha1";
                        };
                };
                fdt {
                        description = "DTB";
                        data = /incbin/("./linux/arch/arm/boot/dts/am335x-boneblack.dtb");
                        type = "flat_dt";
                        arch = "ARM";
                        compression = "none";
                        load = <0x88000000>;
                        entry = <0x88000000>;
                        hash {
                                algo = "sha1";
                        };
                };
        };

        configurations {
                default = "standard";
                standard {
                        description = "Standard Boot";
                        kernel = "kernel";
                        fdt = "fdt";
                        hash {
                                algo = "sha1";
                        };
                };
        };

};              
```
